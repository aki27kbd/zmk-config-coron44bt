## Kconfig
```kconfig
# SPDX-License-Identifier: MIT

config CORON44BT_Z_SHIFT
    bool
    default y if DT_HAS_CORON44BT_Z_SHIFT_ENABLED

menu "coron44bt US symbols on a Windows JIS host"

config ZMK_USJIS
    bool "Translate US symbols for Windows JIS hosts"
    depends on ZMK_OSKEY_STATE
    help
      Translate keyboard-page usages only when oskey selects Windows.
      macOS and Linux use the original US layout. No host setting changes.

if ZMK_USJIS

config ZMK_USJIS_DEFAULT_ENABLED
    bool "Enable translation unless a saved mode overrides it"
    default y

config ZMK_USJIS_MAX_ENTRIES
    int "Maximum held key records"
    range 44 256
    default 82

config ZMK_USJIS_LAYER_MASK
    hex "Layers on which translation applies (zero means all layers)"
    default 0

config ZMK_USJIS_SETTINGS_SAVE_DELAY_MS
    int "Mode setting save debounce in milliseconds"
    default 2000

config ZMK_USJIS_LOG_LEVEL
    int "Translation log level"
    range 0 4
    default 1

endif
endmenu
```

## config/west.yml
```yaml
manifest:
  remotes:
    - name: cormoran
      url-base: https://github.com/cormoran
    - name: mentaldesk
      url-base: https://github.com/mentaldesk
    - name: aki27kbd
      url-base: https://github.com/aki27kbd
  projects:
    - name: zmk
      remote: cormoran
      revision: 1fc72aaff7a42bd533c1f4c9b3f23c5317c745f4 # main+custom-studio-protocol, Zephyr 4.1
      import: app/west.yml
    - name: zmk-pmw3610-driver
      remote: aki27kbd
      revision: e40504993b847166981d6264b1ef3a5c90c1716a
    - name: zmk-feature-custom-settings
      remote: cormoran
      revision: c6a7fef3a3be3d3ace5de9a4b0628c6418cd1f3f
    - name: zmk-module-runtime-input-processor
      remote: cormoran
      revision: decf628d7ce5ed95b520c650824c28ea9de649c1
    - name: zmk-feature-os-detection
      remote: cormoran
      revision: 3052679f645b8fc1997275c2eaa6b86bdd55ca01
    - name: oskey
      remote: mentaldesk
      revision: 78658510090f60a63cbaf551145c66ad722d2980 # main, Zephyr 4.1
  self:
    path: config
```

## dts/bindings/behaviors/coron44bt,z-shift.yaml
```yaml
description: Immediate Shift on another key, with independent single/double Z taps
compatible: "coron44bt,z-shift"
include: zero_param.yaml

properties:
  bindings:
    type: phandle-array
    required: true
    description: Shift hold, lowercase tap, uppercase double tap (in that order)
  hold-term-ms:
    type: int
    default: 180
    description: Hold timeout when no other key is pressed
  double-tap-ms:
    type: int
    default: 200
    description: Time from first release to second press
```

## tests/usjis/Kconfig
```kconfig
mainmenu "coron44bt US-JIS HID simulation"
source "Kconfig.zephyr"

config ZMK_LOG_LEVEL
    int
    default 0

config ZMK_OSKEY_STATE
    bool
    default y

config ZMK_HID_REPORT_TYPE_HKRO
    bool
    default y

config ZMK_HID_KEYBOARD_REPORT_SIZE
    int
    default 6

config ZMK_HID_CONSUMER_REPORT_SIZE
    int
    default 6

config ZMK_HID_CONSUMER_REPORT_USAGES_FULL
    bool
    default y

config ZMK_SPLIT_BLE_CENTRAL_PERIPHERALS
    int
    default 0
```
